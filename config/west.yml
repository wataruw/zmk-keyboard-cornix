## config/west.yml
```yaml
manifest:
  remotes:
    - name: zmkfirmware
      url-base: https://github.com/zmkfirmware
    - name: hitsmaxft
      url-base: https://github.com/hitsmaxft
    - name: urob
      url-base: https://github.com/urob
    - name: janpfischer
      url-base: https://github.com/janpfischer
    - name: wataruw
      url-base: https://github.com/wataruw
  projects:
    - name: zmk
      remote: zmkfirmware
      revision: 0b5a103c187ad337b9f50d824667866c4d7252e1  # Zephyr 4.1更新前
      clone-depth: 1
      import:
        file: app/west.yml
    - name: zmk-naginata
      remote: wataruw
      revision: main
      clone-depth: 1
    - name: zmk-helpers
      remote: urob
      revision: main
      clone-depth: 1
    - name: zmk-rgbled-widget
      remote: hitsmaxft
      revision: main
      clone-depth: 1
    # - name: zmk-dongle-display
    #   remote: hitsmaxft
    #   revision: main
    #   clone-depth: 1
    # - name: zmk-dongle-screen
    #   remote: janpfischer
    #   revision: main
    #   clone-depth: 1
  self:
    path: config
```

## west.yml
```yaml
manifest:
  version: "0.14"
  remotes:
    - name: zmkfirmware
      url-base: https://github.com/zmkfirmware
    - name: wataruw
      url-base: https://github.com/wataruw
  projects:
    - name: zmk
      remote: zmkfirmware
      revision: main
      import:
        path-prefix: modules
        file: app/west.yml
    - name: zmk-naginata
      remote: wataruw
      revision: main
  self:
    path: config
```
